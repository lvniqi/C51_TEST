

/***************************************************************************
实验十九:   DS1302时钟芯片实验
说明:       因为只有四位数码管
            为了方便看到实验效杲只显示分与秒
实验现象:   数码管上显示分与秒 

连线说明:   1,将数码管的a-dot接到P0口		  (连接请注意顺序)
            2,将数码管的s1-s4接到P34-P37
			3,将DS1302分别接以下连接
			  SCLK----------P22
			  I/O ----------P21
			  RST ----------P20
          


****************************************************************************/
/*********************************包含头文件********************************/
#include"normal.h"
#include"led_4.h"
#include"pt.h"
/*********************************端口定义**********************************/
sbit DS1302_CLK = P1^4;
sbit DS1302_IO = P3^2;
sbit DS1302_RST = P3^3;
PT pt;
/******************************定义全局变量*********************************/
uchar second,minute,hour,week,day,month,year;   
const uchar time[]={0x00,0x00,0x00,0x00,0x01,0x47,0x59}; //初始时间数组
/*****************************************************************************
函数功能:向DS1302送一字节数据子程序
入口参数:
出口参数:
*****************************************************************************/
void InputByte(uchar byte)
{
     char i;
     for(i=8;i>0;i--)
     {
     DS1302_IO=(bit)(byte&0x01);
     DS1302_CLK=1;
     _nop_();
     DS1302_CLK=0;
     byte>>=1;
     }
     return;
}

/*****************************************************************************
函数功能:读DS1302一个字节子程序
入口参数:
出口参数:
*****************************************************************************/
uchar outputbyte(void) 
{
      uchar i;
      uchar ucdat=0;
      for(i=8;i>0;i--)
      {
      DS1302_IO=1;
      ucdat>>=1;
      if(DS1302_IO)ucdat|=0x80;
      DS1302_CLK=1;
      _nop_();
      DS1302_CLK=0;
      }
      return(ucdat);
}

/*****************************************************************************
函数功能:向DS1302某地址写一字节数据子程序
入口参数:addr,TDat
出口参数:
*****************************************************************************/
void write_ds1302(uchar addr,uchar TDat)
{
     DS1302_RST=0;
     _nop_();
     DS1302_CLK=0;
     _nop_();
     DS1302_RST=1;
     InputByte(addr);
     _nop_();
     InputByte(TDat);
     DS1302_CLK=1;
     _nop_();
     DS1302_RST=0;
}

/*****************************************************************************
函数功能:读DS1302地址子程序
入口参数:add
出口参数:timedata
*****************************************************************************/
uchar read_ds1302(uchar addr)
{
      uchar timedata;
      DS1302_RST=0;
      _nop_();
      DS1302_CLK=0;
      _nop_();
      DS1302_RST=1;
      InputByte(addr);
      timedata=OutputByte();
      DS1302_CLK=1;
      _nop_();
      DS1302_RST=0;
      return(timedata);
}

/*****************************************************************************
函数功能:初始化DS1302子程序
入口参数:time[](全局变量)
出口参数:
*****************************************************************************/
void initial_ds1302()
{
     write_ds1302(0x8e,0x00);      //写保护寄存器，在对时钟或RAM写前WP一定要为0
     write_ds1302(0x8c,time[0]);   //年
     write_ds1302(0x88,time[1]);   //月
     write_ds1302(0x86,time[2]);   //日
     write_ds1302(0x8A,time[3]);   //星期
     write_ds1302(0x84,time[4]);   //时
     write_ds1302(0x82,time[5]);   //分
     write_ds1302(0x80,time[6]);   //秒
     write_ds1302(0x8e,0x80);      //写保护寄存器
}

/*****************************************************************************
函数功能:读DS1302时间子程序
入口参数:
出口参数:全局变量(second,minute,hour,week,day,month,year)
*****************************************************************************/
static int  read_time(PT* pt)
{
	 uchar temp;
	 PT_BEGIN(pt);
	 while(1)
		{
//		 PT_WAIT_UNTIL(pt,timer_0>=20);
//		 temp=read_ds1302(0x81);   //秒寄存器
//		 write_ds1302(0x00,0x00);	 //记住哦！！！！！！！！！
//		 second=(temp/16)*10+(temp&0x0f);
		 PT_WAIT_UNTIL(pt,timer_0>=1000);
		 temp=read_ds1302(0x83);   //分
		 write_ds1302(0x00,0x00);	 //记住哦！！！！！！！！！
		 minute=(temp/16)*10+(temp&0x0f);
		 PT_WAIT_UNTIL(pt,timer_0>=2000);
		 temp=read_ds1302(0x85);     //时
		 write_ds1302(0x00,0x00);	 //记住哦！！！！！！！！！
		 hour=(temp/16)*10+(temp&0x0f);
//		 PT_WAIT_UNTIL(pt,timer_0>=100);
//		 week=read_ds1302(0x8B);     //星期
//		 write_ds1302(0x00,0x00);	 //记住哦！！！！！！！！！
//		 PT_WAIT_UNTIL(pt,timer_0>=130);
//		 day=read_ds1302(0x87);      //日
//   	 write_ds1302(0x00,0x00);	 //记住哦！！！！！！！！！
//	 	 PT_WAIT_UNTIL(pt,timer_0>=140);
//		 month=read_ds1302(0x89);    //月
//   	 write_ds1302(0x00,0x00);	 //记住哦！！！！！！！！！
//		 PT_WAIT_UNTIL(pt,timer_0>=190);
//		 year=read_ds1302(0x8d);     //年
//	 	 write_ds1302(0x00,0x00);	 //记住哦！！！！！！！！！
		 timer_0=0;
		 Led_set(hour*100+minute);
		}
	PT_END(pt);
}

/*****************************************************************************
函数功能:主程序
入口参数:
出口参数:
*****************************************************************************/
void main(void)
{
//	initial_ds1302();     //初始化DS1302
	PT_INIT(&pt);
	set_timer_0();
	timer_0_start();
    while(1)
     {
	 read_time(&pt);          //读取时间
	 Led_display(LED_Buffer);            //显示时间
     }
}
