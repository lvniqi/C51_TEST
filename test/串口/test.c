/********************************************************************
* 文件名  ： 串口接收试验.c
* 描述    :  该文件实现通过单片机从电脑接收数据。通过数码管显示
			 该试验使用的晶振是11.0592,如果使用12M晶振，会出现串口接收
			 不正常的情况。原因是用12M晶振，波特率9600时的误差率达 8%
			 当下载这个程序到单片机时，单片机的最高为为乱码，是正常现象，
			 按一下复位键便可。是由于单片机下载也是通过串口下载引起的。

***********************************************************************/
#include<reg52.h>
#include<intrins.h>
sbit Led1 = P3^6;
sbit Led2 = P3^7;
sbit Led3 = P3^5;
sbit Led4 = P3^4;
#define uchar unsigned char
#define uint  unsigned int 
sbit BELL = P1^2;		  	//设置P1.2口，为控制蜂鸣器发声的引脚
#define M 4

uchar code table[10] = {0xc0,0xf9,0xa4,0xb0,0x99,0x92,0x82,0xf8,0x80,0x90};
uchar LED_Buffer[4] = {0};      //从串口接收的数据

/********************************************************************
* 名称 : Delay()
* 功能 : 延时子程序，延时时间为 0.1ms * x
* 输入 : x (延时一毫秒的个数)
* 输出 : 无
***********************************************************************/
void Delay(uint i)//0.1ms延时
{
	uchar x,j;
	for(j=0;j<i;j++)
		for(x=0;x<=1;x++);	
}
/********************************************************************
* 名称 : Delay_1ms()
* 功能 : 延时子程序，延时时间为 1ms * x
* 输入 : x (延时一毫秒的个数)
* 输出 : 无
***********************************************************************/
void Delay_1ms(uint i)//1ms延时
{
	uchar x,j;
	for(j=0;j<i;j++)
		for(x=0;x<=148;x++);	
}

/********************************************************************
* 名称 : Bell(int x)
* 功能 : 发声
* 输入 : int x （发声时间）
* 输出 : 无
***********************************************************************/
void Bell(int x)
{
	for(;x>0;x--)
	{
		BELL=0;
		Delay(1);
		BELL=1;
		Delay(1);
	}
	
}
/********************************************************************
* 名称 : Com_Int()
* 功能 : 串口中断子函数
* 输入 : 无
* 输出 : 无
***********************************************************************/
void Com_Int(void) interrupt 4
{
	static uchar i = M-1;    //定义为静态变量，当重新进入这个子函数时 i 的值不会发生改变
	EA = 0;
	if(RI == 1)   //当硬件接收到一个数据时，RI会置位
	{
		LED_Buffer[i] = SBUF - 48; //这里减去48是因为从电脑中发送过来的数据是ASCII码。
		RI = 0;  
		if(0==i) 
			i=M;
		i--;
	}
	EA = 1;
}

/********************************************************************
* 名称 : Com_Init()
* 功能 : 串口初始化，晶振11.0592,波特率9600，使能了串口中断
* 输入 : 无
* 输出 : 无
***********************************************************************/
void Com_Init(void)
{
     TMOD = 0x20;
     PCON = 0x00;
     SCON = 0x50;			
     TH1 = 0xFd;    //设置波特率 9600
     TL1 = 0xFd;
     TR1 = 1;		//启动定时器1
	 ES = 1;		//开串口中断
	 EA = 1;		//开总中断		
}

/********************************************************************
* 名称 : led_display(uint data)
* 功能 : 显示一个数字
* 输入 : int 四位 数字
* 输出 : 无
***********************************************************************/
void led_display(uchar *data1)
{
		Delay_1ms(1);
		P0=table[data1[0]];
		Led1=0;
		Led2=1;
		Led3=1;
		Led4=1;
		Delay_1ms(1);
		P0=table[data1[1]];
		Led1=1;
		Led2=0;
		Led3=1;
		Led4=1;
		Delay_1ms(1);
		P0=table[data1[2]];
		Led1=1;
		Led2=1;
		Led3=0;
		Led4=1;
		Delay_1ms(1);
		P0=table[data1[3]];
		Led1=1;
		Led2=1;
		Led3=1;
		Led4=0;
}
/********************************************************************
* 名称 : Main()
* 功能 : 主函数
* 输入 : 无
* 输出 : 无
***********************************************************************/
void Main()
{
	uchar i = 0;
	Delay_1ms(100);
	Com_Init();
	;  //这里把P3口的最高为置1，进入循环后 循环左移 一位正好是P3 最低为置1
	while(1)
	{
		led_display(LED_Buffer);
		Delay(15);
	}
}						   
